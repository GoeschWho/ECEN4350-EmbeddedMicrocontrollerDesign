.ifndef INCLUDED_CYFITTERGNU_INC
.set INCLUDED_CYFITTERGNU_INC, 1
.include "cydevicegnu.inc"
.include "cydevicegnu_trm.inc"

/* LCD_CS */
.set LCD_CS__0__INTTYPE, CYREG_PICU2_INTTYPE7
.set LCD_CS__0__MASK, 0x80
.set LCD_CS__0__PC, CYREG_PRT2_PC7
.set LCD_CS__0__PORT, 2
.set LCD_CS__0__SHIFT, 7
.set LCD_CS__AG, CYREG_PRT2_AG
.set LCD_CS__AMUX, CYREG_PRT2_AMUX
.set LCD_CS__BIE, CYREG_PRT2_BIE
.set LCD_CS__BIT_MASK, CYREG_PRT2_BIT_MASK
.set LCD_CS__BYP, CYREG_PRT2_BYP
.set LCD_CS__CTL, CYREG_PRT2_CTL
.set LCD_CS__DM0, CYREG_PRT2_DM0
.set LCD_CS__DM1, CYREG_PRT2_DM1
.set LCD_CS__DM2, CYREG_PRT2_DM2
.set LCD_CS__DR, CYREG_PRT2_DR
.set LCD_CS__INP_DIS, CYREG_PRT2_INP_DIS
.set LCD_CS__INTTYPE_BASE, CYDEV_PICU_INTTYPE_PICU2_BASE
.set LCD_CS__LCD_COM_SEG, CYREG_PRT2_LCD_COM_SEG
.set LCD_CS__LCD_EN, CYREG_PRT2_LCD_EN
.set LCD_CS__MASK, 0x80
.set LCD_CS__PORT, 2
.set LCD_CS__PRT, CYREG_PRT2_PRT
.set LCD_CS__PRTDSI__CAPS_SEL, CYREG_PRT2_CAPS_SEL
.set LCD_CS__PRTDSI__DBL_SYNC_IN, CYREG_PRT2_DBL_SYNC_IN
.set LCD_CS__PRTDSI__OE_SEL0, CYREG_PRT2_OE_SEL0
.set LCD_CS__PRTDSI__OE_SEL1, CYREG_PRT2_OE_SEL1
.set LCD_CS__PRTDSI__OUT_SEL0, CYREG_PRT2_OUT_SEL0
.set LCD_CS__PRTDSI__OUT_SEL1, CYREG_PRT2_OUT_SEL1
.set LCD_CS__PRTDSI__SYNC_OUT, CYREG_PRT2_SYNC_OUT
.set LCD_CS__PS, CYREG_PRT2_PS
.set LCD_CS__SHIFT, 7
.set LCD_CS__SLW, CYREG_PRT2_SLW

/* LCD_DC */
.set LCD_DC__0__INTTYPE, CYREG_PICU2_INTTYPE3
.set LCD_DC__0__MASK, 0x08
.set LCD_DC__0__PC, CYREG_PRT2_PC3
.set LCD_DC__0__PORT, 2
.set LCD_DC__0__SHIFT, 3
.set LCD_DC__AG, CYREG_PRT2_AG
.set LCD_DC__AMUX, CYREG_PRT2_AMUX
.set LCD_DC__BIE, CYREG_PRT2_BIE
.set LCD_DC__BIT_MASK, CYREG_PRT2_BIT_MASK
.set LCD_DC__BYP, CYREG_PRT2_BYP
.set LCD_DC__CTL, CYREG_PRT2_CTL
.set LCD_DC__DM0, CYREG_PRT2_DM0
.set LCD_DC__DM1, CYREG_PRT2_DM1
.set LCD_DC__DM2, CYREG_PRT2_DM2
.set LCD_DC__DR, CYREG_PRT2_DR
.set LCD_DC__INP_DIS, CYREG_PRT2_INP_DIS
.set LCD_DC__INTTYPE_BASE, CYDEV_PICU_INTTYPE_PICU2_BASE
.set LCD_DC__LCD_COM_SEG, CYREG_PRT2_LCD_COM_SEG
.set LCD_DC__LCD_EN, CYREG_PRT2_LCD_EN
.set LCD_DC__MASK, 0x08
.set LCD_DC__PORT, 2
.set LCD_DC__PRT, CYREG_PRT2_PRT
.set LCD_DC__PRTDSI__CAPS_SEL, CYREG_PRT2_CAPS_SEL
.set LCD_DC__PRTDSI__DBL_SYNC_IN, CYREG_PRT2_DBL_SYNC_IN
.set LCD_DC__PRTDSI__OE_SEL0, CYREG_PRT2_OE_SEL0
.set LCD_DC__PRTDSI__OE_SEL1, CYREG_PRT2_OE_SEL1
.set LCD_DC__PRTDSI__OUT_SEL0, CYREG_PRT2_OUT_SEL0
.set LCD_DC__PRTDSI__OUT_SEL1, CYREG_PRT2_OUT_SEL1
.set LCD_DC__PRTDSI__SYNC_OUT, CYREG_PRT2_SYNC_OUT
.set LCD_DC__PS, CYREG_PRT2_PS
.set LCD_DC__SHIFT, 3
.set LCD_DC__SLW, CYREG_PRT2_SLW

/* LCD_RST */
.set LCD_RST__0__INTTYPE, CYREG_PICU2_INTTYPE0
.set LCD_RST__0__MASK, 0x01
.set LCD_RST__0__PC, CYREG_PRT2_PC0
.set LCD_RST__0__PORT, 2
.set LCD_RST__0__SHIFT, 0
.set LCD_RST__AG, CYREG_PRT2_AG
.set LCD_RST__AMUX, CYREG_PRT2_AMUX
.set LCD_RST__BIE, CYREG_PRT2_BIE
.set LCD_RST__BIT_MASK, CYREG_PRT2_BIT_MASK
.set LCD_RST__BYP, CYREG_PRT2_BYP
.set LCD_RST__CTL, CYREG_PRT2_CTL
.set LCD_RST__DM0, CYREG_PRT2_DM0
.set LCD_RST__DM1, CYREG_PRT2_DM1
.set LCD_RST__DM2, CYREG_PRT2_DM2
.set LCD_RST__DR, CYREG_PRT2_DR
.set LCD_RST__INP_DIS, CYREG_PRT2_INP_DIS
.set LCD_RST__INTTYPE_BASE, CYDEV_PICU_INTTYPE_PICU2_BASE
.set LCD_RST__LCD_COM_SEG, CYREG_PRT2_LCD_COM_SEG
.set LCD_RST__LCD_EN, CYREG_PRT2_LCD_EN
.set LCD_RST__MASK, 0x01
.set LCD_RST__PORT, 2
.set LCD_RST__PRT, CYREG_PRT2_PRT
.set LCD_RST__PRTDSI__CAPS_SEL, CYREG_PRT2_CAPS_SEL
.set LCD_RST__PRTDSI__DBL_SYNC_IN, CYREG_PRT2_DBL_SYNC_IN
.set LCD_RST__PRTDSI__OE_SEL0, CYREG_PRT2_OE_SEL0
.set LCD_RST__PRTDSI__OE_SEL1, CYREG_PRT2_OE_SEL1
.set LCD_RST__PRTDSI__OUT_SEL0, CYREG_PRT2_OUT_SEL0
.set LCD_RST__PRTDSI__OUT_SEL1, CYREG_PRT2_OUT_SEL1
.set LCD_RST__PRTDSI__SYNC_OUT, CYREG_PRT2_SYNC_OUT
.set LCD_RST__PS, CYREG_PRT2_PS
.set LCD_RST__SHIFT, 0
.set LCD_RST__SLW, CYREG_PRT2_SLW

/* LCD_SCK */
.set LCD_SCK__0__INTTYPE, CYREG_PICU2_INTTYPE6
.set LCD_SCK__0__MASK, 0x40
.set LCD_SCK__0__PC, CYREG_PRT2_PC6
.set LCD_SCK__0__PORT, 2
.set LCD_SCK__0__SHIFT, 6
.set LCD_SCK__AG, CYREG_PRT2_AG
.set LCD_SCK__AMUX, CYREG_PRT2_AMUX
.set LCD_SCK__BIE, CYREG_PRT2_BIE
.set LCD_SCK__BIT_MASK, CYREG_PRT2_BIT_MASK
.set LCD_SCK__BYP, CYREG_PRT2_BYP
.set LCD_SCK__CTL, CYREG_PRT2_CTL
.set LCD_SCK__DM0, CYREG_PRT2_DM0
.set LCD_SCK__DM1, CYREG_PRT2_DM1
.set LCD_SCK__DM2, CYREG_PRT2_DM2
.set LCD_SCK__DR, CYREG_PRT2_DR
.set LCD_SCK__INP_DIS, CYREG_PRT2_INP_DIS
.set LCD_SCK__INTTYPE_BASE, CYDEV_PICU_INTTYPE_PICU2_BASE
.set LCD_SCK__LCD_COM_SEG, CYREG_PRT2_LCD_COM_SEG
.set LCD_SCK__LCD_EN, CYREG_PRT2_LCD_EN
.set LCD_SCK__MASK, 0x40
.set LCD_SCK__PORT, 2
.set LCD_SCK__PRT, CYREG_PRT2_PRT
.set LCD_SCK__PRTDSI__CAPS_SEL, CYREG_PRT2_CAPS_SEL
.set LCD_SCK__PRTDSI__DBL_SYNC_IN, CYREG_PRT2_DBL_SYNC_IN
.set LCD_SCK__PRTDSI__OE_SEL0, CYREG_PRT2_OE_SEL0
.set LCD_SCK__PRTDSI__OE_SEL1, CYREG_PRT2_OE_SEL1
.set LCD_SCK__PRTDSI__OUT_SEL0, CYREG_PRT2_OUT_SEL0
.set LCD_SCK__PRTDSI__OUT_SEL1, CYREG_PRT2_OUT_SEL1
.set LCD_SCK__PRTDSI__SYNC_OUT, CYREG_PRT2_SYNC_OUT
.set LCD_SCK__PS, CYREG_PRT2_PS
.set LCD_SCK__SHIFT, 6
.set LCD_SCK__SLW, CYREG_PRT2_SLW

/* LCD_SPI_BSPIM */
.set LCD_SPI_BSPIM_BitCounter__16BIT_CONTROL_AUX_CTL_REG, CYREG_B0_UDB12_13_ACTL
.set LCD_SPI_BSPIM_BitCounter__16BIT_CONTROL_CONTROL_REG, CYREG_B0_UDB12_13_CTL
.set LCD_SPI_BSPIM_BitCounter__16BIT_CONTROL_COUNT_REG, CYREG_B0_UDB12_13_CTL
.set LCD_SPI_BSPIM_BitCounter__16BIT_COUNT_CONTROL_REG, CYREG_B0_UDB12_13_CTL
.set LCD_SPI_BSPIM_BitCounter__16BIT_COUNT_COUNT_REG, CYREG_B0_UDB12_13_CTL
.set LCD_SPI_BSPIM_BitCounter__16BIT_MASK_MASK_REG, CYREG_B0_UDB12_13_MSK
.set LCD_SPI_BSPIM_BitCounter__16BIT_MASK_PERIOD_REG, CYREG_B0_UDB12_13_MSK
.set LCD_SPI_BSPIM_BitCounter__16BIT_PERIOD_MASK_REG, CYREG_B0_UDB12_13_MSK
.set LCD_SPI_BSPIM_BitCounter__16BIT_PERIOD_PERIOD_REG, CYREG_B0_UDB12_13_MSK
.set LCD_SPI_BSPIM_BitCounter__CONTROL_AUX_CTL_REG, CYREG_B0_UDB12_ACTL
.set LCD_SPI_BSPIM_BitCounter__CONTROL_REG, CYREG_B0_UDB12_CTL
.set LCD_SPI_BSPIM_BitCounter__CONTROL_ST_REG, CYREG_B0_UDB12_ST_CTL
.set LCD_SPI_BSPIM_BitCounter__COUNT_REG, CYREG_B0_UDB12_CTL
.set LCD_SPI_BSPIM_BitCounter__COUNT_ST_REG, CYREG_B0_UDB12_ST_CTL
.set LCD_SPI_BSPIM_BitCounter__MASK_CTL_AUX_CTL_REG, CYREG_B0_UDB12_MSK_ACTL
.set LCD_SPI_BSPIM_BitCounter__PER_CTL_AUX_CTL_REG, CYREG_B0_UDB12_MSK_ACTL
.set LCD_SPI_BSPIM_BitCounter__PERIOD_REG, CYREG_B0_UDB12_MSK
.set LCD_SPI_BSPIM_BitCounter_ST__16BIT_STATUS_AUX_CTL_REG, CYREG_B0_UDB12_13_ACTL
.set LCD_SPI_BSPIM_BitCounter_ST__16BIT_STATUS_REG, CYREG_B0_UDB12_13_ST
.set LCD_SPI_BSPIM_BitCounter_ST__MASK_REG, CYREG_B0_UDB12_MSK
.set LCD_SPI_BSPIM_BitCounter_ST__MASK_ST_AUX_CTL_REG, CYREG_B0_UDB12_MSK_ACTL
.set LCD_SPI_BSPIM_BitCounter_ST__PER_ST_AUX_CTL_REG, CYREG_B0_UDB12_MSK_ACTL
.set LCD_SPI_BSPIM_BitCounter_ST__STATUS_AUX_CTL_REG, CYREG_B0_UDB12_ACTL
.set LCD_SPI_BSPIM_BitCounter_ST__STATUS_CNT_REG, CYREG_B0_UDB12_ST_CTL
.set LCD_SPI_BSPIM_BitCounter_ST__STATUS_CONTROL_REG, CYREG_B0_UDB12_ST_CTL
.set LCD_SPI_BSPIM_BitCounter_ST__STATUS_REG, CYREG_B0_UDB12_ST
.set LCD_SPI_BSPIM_RxStsReg__16BIT_STATUS_AUX_CTL_REG, CYREG_B0_UDB11_12_ACTL
.set LCD_SPI_BSPIM_RxStsReg__16BIT_STATUS_REG, CYREG_B0_UDB11_12_ST
.set LCD_SPI_BSPIM_RxStsReg__4__MASK, 0x10
.set LCD_SPI_BSPIM_RxStsReg__4__POS, 4
.set LCD_SPI_BSPIM_RxStsReg__5__MASK, 0x20
.set LCD_SPI_BSPIM_RxStsReg__5__POS, 5
.set LCD_SPI_BSPIM_RxStsReg__6__MASK, 0x40
.set LCD_SPI_BSPIM_RxStsReg__6__POS, 6
.set LCD_SPI_BSPIM_RxStsReg__MASK, 0x70
.set LCD_SPI_BSPIM_RxStsReg__MASK_REG, CYREG_B0_UDB11_MSK
.set LCD_SPI_BSPIM_RxStsReg__STATUS_AUX_CTL_REG, CYREG_B0_UDB11_ACTL
.set LCD_SPI_BSPIM_RxStsReg__STATUS_REG, CYREG_B0_UDB11_ST
.set LCD_SPI_BSPIM_sR8_Dp_u0__16BIT_A0_REG, CYREG_B0_UDB10_11_A0
.set LCD_SPI_BSPIM_sR8_Dp_u0__16BIT_A1_REG, CYREG_B0_UDB10_11_A1
.set LCD_SPI_BSPIM_sR8_Dp_u0__16BIT_D0_REG, CYREG_B0_UDB10_11_D0
.set LCD_SPI_BSPIM_sR8_Dp_u0__16BIT_D1_REG, CYREG_B0_UDB10_11_D1
.set LCD_SPI_BSPIM_sR8_Dp_u0__16BIT_DP_AUX_CTL_REG, CYREG_B0_UDB10_11_ACTL
.set LCD_SPI_BSPIM_sR8_Dp_u0__16BIT_F0_REG, CYREG_B0_UDB10_11_F0
.set LCD_SPI_BSPIM_sR8_Dp_u0__16BIT_F1_REG, CYREG_B0_UDB10_11_F1
.set LCD_SPI_BSPIM_sR8_Dp_u0__A0_A1_REG, CYREG_B0_UDB10_A0_A1
.set LCD_SPI_BSPIM_sR8_Dp_u0__A0_REG, CYREG_B0_UDB10_A0
.set LCD_SPI_BSPIM_sR8_Dp_u0__A1_REG, CYREG_B0_UDB10_A1
.set LCD_SPI_BSPIM_sR8_Dp_u0__D0_D1_REG, CYREG_B0_UDB10_D0_D1
.set LCD_SPI_BSPIM_sR8_Dp_u0__D0_REG, CYREG_B0_UDB10_D0
.set LCD_SPI_BSPIM_sR8_Dp_u0__D1_REG, CYREG_B0_UDB10_D1
.set LCD_SPI_BSPIM_sR8_Dp_u0__DP_AUX_CTL_REG, CYREG_B0_UDB10_ACTL
.set LCD_SPI_BSPIM_sR8_Dp_u0__F0_F1_REG, CYREG_B0_UDB10_F0_F1
.set LCD_SPI_BSPIM_sR8_Dp_u0__F0_REG, CYREG_B0_UDB10_F0
.set LCD_SPI_BSPIM_sR8_Dp_u0__F1_REG, CYREG_B0_UDB10_F1
.set LCD_SPI_BSPIM_TxStsReg__0__MASK, 0x01
.set LCD_SPI_BSPIM_TxStsReg__0__POS, 0
.set LCD_SPI_BSPIM_TxStsReg__1__MASK, 0x02
.set LCD_SPI_BSPIM_TxStsReg__1__POS, 1
.set LCD_SPI_BSPIM_TxStsReg__16BIT_STATUS_AUX_CTL_REG, CYREG_B0_UDB10_11_ACTL
.set LCD_SPI_BSPIM_TxStsReg__16BIT_STATUS_REG, CYREG_B0_UDB10_11_ST
.set LCD_SPI_BSPIM_TxStsReg__2__MASK, 0x04
.set LCD_SPI_BSPIM_TxStsReg__2__POS, 2
.set LCD_SPI_BSPIM_TxStsReg__3__MASK, 0x08
.set LCD_SPI_BSPIM_TxStsReg__3__POS, 3
.set LCD_SPI_BSPIM_TxStsReg__4__MASK, 0x10
.set LCD_SPI_BSPIM_TxStsReg__4__POS, 4
.set LCD_SPI_BSPIM_TxStsReg__MASK, 0x1F
.set LCD_SPI_BSPIM_TxStsReg__MASK_REG, CYREG_B0_UDB10_MSK
.set LCD_SPI_BSPIM_TxStsReg__STATUS_AUX_CTL_REG, CYREG_B0_UDB10_ACTL
.set LCD_SPI_BSPIM_TxStsReg__STATUS_REG, CYREG_B0_UDB10_ST

/* LCD_SPI_IntClock */
.set LCD_SPI_IntClock__CFG0, CYREG_CLKDIST_DCFG0_CFG0
.set LCD_SPI_IntClock__CFG1, CYREG_CLKDIST_DCFG0_CFG1
.set LCD_SPI_IntClock__CFG2, CYREG_CLKDIST_DCFG0_CFG2
.set LCD_SPI_IntClock__CFG2_SRC_SEL_MASK, 0x07
.set LCD_SPI_IntClock__INDEX, 0x00
.set LCD_SPI_IntClock__PM_ACT_CFG, CYREG_PM_ACT_CFG2
.set LCD_SPI_IntClock__PM_ACT_MSK, 0x01
.set LCD_SPI_IntClock__PM_STBY_CFG, CYREG_PM_STBY_CFG2
.set LCD_SPI_IntClock__PM_STBY_MSK, 0x01

/* LCD_SPI_RxInternalInterrupt */
.set LCD_SPI_RxInternalInterrupt__INTC_CLR_EN_REG, CYREG_NVIC_CLRENA0
.set LCD_SPI_RxInternalInterrupt__INTC_CLR_PD_REG, CYREG_NVIC_CLRPEND0
.set LCD_SPI_RxInternalInterrupt__INTC_MASK, 0x01
.set LCD_SPI_RxInternalInterrupt__INTC_NUMBER, 0
.set LCD_SPI_RxInternalInterrupt__INTC_PRIOR_NUM, 7
.set LCD_SPI_RxInternalInterrupt__INTC_PRIOR_REG, CYREG_NVIC_PRI_0
.set LCD_SPI_RxInternalInterrupt__INTC_SET_EN_REG, CYREG_NVIC_SETENA0
.set LCD_SPI_RxInternalInterrupt__INTC_SET_PD_REG, CYREG_NVIC_SETPEND0

/* LCD_SPI_TxInternalInterrupt */
.set LCD_SPI_TxInternalInterrupt__INTC_CLR_EN_REG, CYREG_NVIC_CLRENA0
.set LCD_SPI_TxInternalInterrupt__INTC_CLR_PD_REG, CYREG_NVIC_CLRPEND0
.set LCD_SPI_TxInternalInterrupt__INTC_MASK, 0x02
.set LCD_SPI_TxInternalInterrupt__INTC_NUMBER, 1
.set LCD_SPI_TxInternalInterrupt__INTC_PRIOR_NUM, 7
.set LCD_SPI_TxInternalInterrupt__INTC_PRIOR_REG, CYREG_NVIC_PRI_1
.set LCD_SPI_TxInternalInterrupt__INTC_SET_EN_REG, CYREG_NVIC_SETENA0
.set LCD_SPI_TxInternalInterrupt__INTC_SET_PD_REG, CYREG_NVIC_SETPEND0

/* LCD_MISO */
.set LCD_MISO__0__INTTYPE, CYREG_PICU2_INTTYPE4
.set LCD_MISO__0__MASK, 0x10
.set LCD_MISO__0__PC, CYREG_PRT2_PC4
.set LCD_MISO__0__PORT, 2
.set LCD_MISO__0__SHIFT, 4
.set LCD_MISO__AG, CYREG_PRT2_AG
.set LCD_MISO__AMUX, CYREG_PRT2_AMUX
.set LCD_MISO__BIE, CYREG_PRT2_BIE
.set LCD_MISO__BIT_MASK, CYREG_PRT2_BIT_MASK
.set LCD_MISO__BYP, CYREG_PRT2_BYP
.set LCD_MISO__CTL, CYREG_PRT2_CTL
.set LCD_MISO__DM0, CYREG_PRT2_DM0
.set LCD_MISO__DM1, CYREG_PRT2_DM1
.set LCD_MISO__DM2, CYREG_PRT2_DM2
.set LCD_MISO__DR, CYREG_PRT2_DR
.set LCD_MISO__INP_DIS, CYREG_PRT2_INP_DIS
.set LCD_MISO__INTTYPE_BASE, CYDEV_PICU_INTTYPE_PICU2_BASE
.set LCD_MISO__LCD_COM_SEG, CYREG_PRT2_LCD_COM_SEG
.set LCD_MISO__LCD_EN, CYREG_PRT2_LCD_EN
.set LCD_MISO__MASK, 0x10
.set LCD_MISO__PORT, 2
.set LCD_MISO__PRT, CYREG_PRT2_PRT
.set LCD_MISO__PRTDSI__CAPS_SEL, CYREG_PRT2_CAPS_SEL
.set LCD_MISO__PRTDSI__DBL_SYNC_IN, CYREG_PRT2_DBL_SYNC_IN
.set LCD_MISO__PRTDSI__OE_SEL0, CYREG_PRT2_OE_SEL0
.set LCD_MISO__PRTDSI__OE_SEL1, CYREG_PRT2_OE_SEL1
.set LCD_MISO__PRTDSI__OUT_SEL0, CYREG_PRT2_OUT_SEL0
.set LCD_MISO__PRTDSI__OUT_SEL1, CYREG_PRT2_OUT_SEL1
.set LCD_MISO__PRTDSI__SYNC_OUT, CYREG_PRT2_SYNC_OUT
.set LCD_MISO__PS, CYREG_PRT2_PS
.set LCD_MISO__SHIFT, 4
.set LCD_MISO__SLW, CYREG_PRT2_SLW

/* LCD_MOSI */
.set LCD_MOSI__0__INTTYPE, CYREG_PICU2_INTTYPE5
.set LCD_MOSI__0__MASK, 0x20
.set LCD_MOSI__0__PC, CYREG_PRT2_PC5
.set LCD_MOSI__0__PORT, 2
.set LCD_MOSI__0__SHIFT, 5
.set LCD_MOSI__AG, CYREG_PRT2_AG
.set LCD_MOSI__AMUX, CYREG_PRT2_AMUX
.set LCD_MOSI__BIE, CYREG_PRT2_BIE
.set LCD_MOSI__BIT_MASK, CYREG_PRT2_BIT_MASK
.set LCD_MOSI__BYP, CYREG_PRT2_BYP
.set LCD_MOSI__CTL, CYREG_PRT2_CTL
.set LCD_MOSI__DM0, CYREG_PRT2_DM0
.set LCD_MOSI__DM1, CYREG_PRT2_DM1
.set LCD_MOSI__DM2, CYREG_PRT2_DM2
.set LCD_MOSI__DR, CYREG_PRT2_DR
.set LCD_MOSI__INP_DIS, CYREG_PRT2_INP_DIS
.set LCD_MOSI__INTTYPE_BASE, CYDEV_PICU_INTTYPE_PICU2_BASE
.set LCD_MOSI__LCD_COM_SEG, CYREG_PRT2_LCD_COM_SEG
.set LCD_MOSI__LCD_EN, CYREG_PRT2_LCD_EN
.set LCD_MOSI__MASK, 0x20
.set LCD_MOSI__PORT, 2
.set LCD_MOSI__PRT, CYREG_PRT2_PRT
.set LCD_MOSI__PRTDSI__CAPS_SEL, CYREG_PRT2_CAPS_SEL
.set LCD_MOSI__PRTDSI__DBL_SYNC_IN, CYREG_PRT2_DBL_SYNC_IN
.set LCD_MOSI__PRTDSI__OE_SEL0, CYREG_PRT2_OE_SEL0
.set LCD_MOSI__PRTDSI__OE_SEL1, CYREG_PRT2_OE_SEL1
.set LCD_MOSI__PRTDSI__OUT_SEL0, CYREG_PRT2_OUT_SEL0
.set LCD_MOSI__PRTDSI__OUT_SEL1, CYREG_PRT2_OUT_SEL1
.set LCD_MOSI__PRTDSI__SYNC_OUT, CYREG_PRT2_SYNC_OUT
.set LCD_MOSI__PS, CYREG_PRT2_PS
.set LCD_MOSI__SHIFT, 5
.set LCD_MOSI__SLW, CYREG_PRT2_SLW

/* Systick_Timer_TimerHW */
.set Systick_Timer_TimerHW__CAP0, CYREG_TMR0_CAP0
.set Systick_Timer_TimerHW__CAP1, CYREG_TMR0_CAP1
.set Systick_Timer_TimerHW__CFG0, CYREG_TMR0_CFG0
.set Systick_Timer_TimerHW__CFG1, CYREG_TMR0_CFG1
.set Systick_Timer_TimerHW__CFG2, CYREG_TMR0_CFG2
.set Systick_Timer_TimerHW__CNT_CMP0, CYREG_TMR0_CNT_CMP0
.set Systick_Timer_TimerHW__CNT_CMP1, CYREG_TMR0_CNT_CMP1
.set Systick_Timer_TimerHW__PER0, CYREG_TMR0_PER0
.set Systick_Timer_TimerHW__PER1, CYREG_TMR0_PER1
.set Systick_Timer_TimerHW__PM_ACT_CFG, CYREG_PM_ACT_CFG3
.set Systick_Timer_TimerHW__PM_ACT_MSK, 0x01
.set Systick_Timer_TimerHW__PM_STBY_CFG, CYREG_PM_STBY_CFG3
.set Systick_Timer_TimerHW__PM_STBY_MSK, 0x01
.set Systick_Timer_TimerHW__RT0, CYREG_TMR0_RT0
.set Systick_Timer_TimerHW__RT1, CYREG_TMR0_RT1
.set Systick_Timer_TimerHW__SR0, CYREG_TMR0_SR0

/* Systick_Counter_CounterUDB */
.set Systick_Counter_CounterUDB_sC32_counterdp_u0__16BIT_A0_REG, CYREG_B1_UDB04_05_A0
.set Systick_Counter_CounterUDB_sC32_counterdp_u0__16BIT_A1_REG, CYREG_B1_UDB04_05_A1
.set Systick_Counter_CounterUDB_sC32_counterdp_u0__16BIT_D0_REG, CYREG_B1_UDB04_05_D0
.set Systick_Counter_CounterUDB_sC32_counterdp_u0__16BIT_D1_REG, CYREG_B1_UDB04_05_D1
.set Systick_Counter_CounterUDB_sC32_counterdp_u0__16BIT_DP_AUX_CTL_REG, CYREG_B1_UDB04_05_ACTL
.set Systick_Counter_CounterUDB_sC32_counterdp_u0__16BIT_F0_REG, CYREG_B1_UDB04_05_F0
.set Systick_Counter_CounterUDB_sC32_counterdp_u0__16BIT_F1_REG, CYREG_B1_UDB04_05_F1
.set Systick_Counter_CounterUDB_sC32_counterdp_u0__A0_A1_REG, CYREG_B1_UDB04_A0_A1
.set Systick_Counter_CounterUDB_sC32_counterdp_u0__A0_REG, CYREG_B1_UDB04_A0
.set Systick_Counter_CounterUDB_sC32_counterdp_u0__A1_REG, CYREG_B1_UDB04_A1
.set Systick_Counter_CounterUDB_sC32_counterdp_u0__D0_D1_REG, CYREG_B1_UDB04_D0_D1
.set Systick_Counter_CounterUDB_sC32_counterdp_u0__D0_REG, CYREG_B1_UDB04_D0
.set Systick_Counter_CounterUDB_sC32_counterdp_u0__D1_REG, CYREG_B1_UDB04_D1
.set Systick_Counter_CounterUDB_sC32_counterdp_u0__DP_AUX_CTL_REG, CYREG_B1_UDB04_ACTL
.set Systick_Counter_CounterUDB_sC32_counterdp_u0__F0_F1_REG, CYREG_B1_UDB04_F0_F1
.set Systick_Counter_CounterUDB_sC32_counterdp_u0__F0_REG, CYREG_B1_UDB04_F0
.set Systick_Counter_CounterUDB_sC32_counterdp_u0__F1_REG, CYREG_B1_UDB04_F1
.set Systick_Counter_CounterUDB_sC32_counterdp_u1__16BIT_A0_REG, CYREG_B1_UDB05_06_A0
.set Systick_Counter_CounterUDB_sC32_counterdp_u1__16BIT_A1_REG, CYREG_B1_UDB05_06_A1
.set Systick_Counter_CounterUDB_sC32_counterdp_u1__16BIT_D0_REG, CYREG_B1_UDB05_06_D0
.set Systick_Counter_CounterUDB_sC32_counterdp_u1__16BIT_D1_REG, CYREG_B1_UDB05_06_D1
.set Systick_Counter_CounterUDB_sC32_counterdp_u1__16BIT_DP_AUX_CTL_REG, CYREG_B1_UDB05_06_ACTL
.set Systick_Counter_CounterUDB_sC32_counterdp_u1__16BIT_F0_REG, CYREG_B1_UDB05_06_F0
.set Systick_Counter_CounterUDB_sC32_counterdp_u1__16BIT_F1_REG, CYREG_B1_UDB05_06_F1
.set Systick_Counter_CounterUDB_sC32_counterdp_u1__A0_A1_REG, CYREG_B1_UDB05_A0_A1
.set Systick_Counter_CounterUDB_sC32_counterdp_u1__A0_REG, CYREG_B1_UDB05_A0
.set Systick_Counter_CounterUDB_sC32_counterdp_u1__A1_REG, CYREG_B1_UDB05_A1
.set Systick_Counter_CounterUDB_sC32_counterdp_u1__D0_D1_REG, CYREG_B1_UDB05_D0_D1
.set Systick_Counter_CounterUDB_sC32_counterdp_u1__D0_REG, CYREG_B1_UDB05_D0
.set Systick_Counter_CounterUDB_sC32_counterdp_u1__D1_REG, CYREG_B1_UDB05_D1
.set Systick_Counter_CounterUDB_sC32_counterdp_u1__DP_AUX_CTL_REG, CYREG_B1_UDB05_ACTL
.set Systick_Counter_CounterUDB_sC32_counterdp_u1__F0_F1_REG, CYREG_B1_UDB05_F0_F1
.set Systick_Counter_CounterUDB_sC32_counterdp_u1__F0_REG, CYREG_B1_UDB05_F0
.set Systick_Counter_CounterUDB_sC32_counterdp_u1__F1_REG, CYREG_B1_UDB05_F1
.set Systick_Counter_CounterUDB_sC32_counterdp_u1__MSK_DP_AUX_CTL_REG, CYREG_B1_UDB05_MSK_ACTL
.set Systick_Counter_CounterUDB_sC32_counterdp_u1__PER_DP_AUX_CTL_REG, CYREG_B1_UDB05_MSK_ACTL
.set Systick_Counter_CounterUDB_sC32_counterdp_u2__16BIT_A0_REG, CYREG_B1_UDB06_07_A0
.set Systick_Counter_CounterUDB_sC32_counterdp_u2__16BIT_A1_REG, CYREG_B1_UDB06_07_A1
.set Systick_Counter_CounterUDB_sC32_counterdp_u2__16BIT_D0_REG, CYREG_B1_UDB06_07_D0
.set Systick_Counter_CounterUDB_sC32_counterdp_u2__16BIT_D1_REG, CYREG_B1_UDB06_07_D1
.set Systick_Counter_CounterUDB_sC32_counterdp_u2__16BIT_DP_AUX_CTL_REG, CYREG_B1_UDB06_07_ACTL
.set Systick_Counter_CounterUDB_sC32_counterdp_u2__16BIT_F0_REG, CYREG_B1_UDB06_07_F0
.set Systick_Counter_CounterUDB_sC32_counterdp_u2__16BIT_F1_REG, CYREG_B1_UDB06_07_F1
.set Systick_Counter_CounterUDB_sC32_counterdp_u2__A0_A1_REG, CYREG_B1_UDB06_A0_A1
.set Systick_Counter_CounterUDB_sC32_counterdp_u2__A0_REG, CYREG_B1_UDB06_A0
.set Systick_Counter_CounterUDB_sC32_counterdp_u2__A1_REG, CYREG_B1_UDB06_A1
.set Systick_Counter_CounterUDB_sC32_counterdp_u2__D0_D1_REG, CYREG_B1_UDB06_D0_D1
.set Systick_Counter_CounterUDB_sC32_counterdp_u2__D0_REG, CYREG_B1_UDB06_D0
.set Systick_Counter_CounterUDB_sC32_counterdp_u2__D1_REG, CYREG_B1_UDB06_D1
.set Systick_Counter_CounterUDB_sC32_counterdp_u2__DP_AUX_CTL_REG, CYREG_B1_UDB06_ACTL
.set Systick_Counter_CounterUDB_sC32_counterdp_u2__F0_F1_REG, CYREG_B1_UDB06_F0_F1
.set Systick_Counter_CounterUDB_sC32_counterdp_u2__F0_REG, CYREG_B1_UDB06_F0
.set Systick_Counter_CounterUDB_sC32_counterdp_u2__F1_REG, CYREG_B1_UDB06_F1
.set Systick_Counter_CounterUDB_sC32_counterdp_u3__16BIT_A0_REG, CYREG_B1_UDB07_08_A0
.set Systick_Counter_CounterUDB_sC32_counterdp_u3__16BIT_A1_REG, CYREG_B1_UDB07_08_A1
.set Systick_Counter_CounterUDB_sC32_counterdp_u3__16BIT_D0_REG, CYREG_B1_UDB07_08_D0
.set Systick_Counter_CounterUDB_sC32_counterdp_u3__16BIT_D1_REG, CYREG_B1_UDB07_08_D1
.set Systick_Counter_CounterUDB_sC32_counterdp_u3__16BIT_DP_AUX_CTL_REG, CYREG_B1_UDB07_08_ACTL
.set Systick_Counter_CounterUDB_sC32_counterdp_u3__16BIT_F0_REG, CYREG_B1_UDB07_08_F0
.set Systick_Counter_CounterUDB_sC32_counterdp_u3__16BIT_F1_REG, CYREG_B1_UDB07_08_F1
.set Systick_Counter_CounterUDB_sC32_counterdp_u3__A0_A1_REG, CYREG_B1_UDB07_A0_A1
.set Systick_Counter_CounterUDB_sC32_counterdp_u3__A0_REG, CYREG_B1_UDB07_A0
.set Systick_Counter_CounterUDB_sC32_counterdp_u3__A1_REG, CYREG_B1_UDB07_A1
.set Systick_Counter_CounterUDB_sC32_counterdp_u3__D0_D1_REG, CYREG_B1_UDB07_D0_D1
.set Systick_Counter_CounterUDB_sC32_counterdp_u3__D0_REG, CYREG_B1_UDB07_D0
.set Systick_Counter_CounterUDB_sC32_counterdp_u3__D1_REG, CYREG_B1_UDB07_D1
.set Systick_Counter_CounterUDB_sC32_counterdp_u3__DP_AUX_CTL_REG, CYREG_B1_UDB07_ACTL
.set Systick_Counter_CounterUDB_sC32_counterdp_u3__F0_F1_REG, CYREG_B1_UDB07_F0_F1
.set Systick_Counter_CounterUDB_sC32_counterdp_u3__F0_REG, CYREG_B1_UDB07_F0
.set Systick_Counter_CounterUDB_sC32_counterdp_u3__F1_REG, CYREG_B1_UDB07_F1
.set Systick_Counter_CounterUDB_sCTRLReg_ctrlreg__16BIT_CONTROL_AUX_CTL_REG, CYREG_B1_UDB05_06_ACTL
.set Systick_Counter_CounterUDB_sCTRLReg_ctrlreg__16BIT_CONTROL_CONTROL_REG, CYREG_B1_UDB05_06_CTL
.set Systick_Counter_CounterUDB_sCTRLReg_ctrlreg__16BIT_CONTROL_COUNT_REG, CYREG_B1_UDB05_06_CTL
.set Systick_Counter_CounterUDB_sCTRLReg_ctrlreg__16BIT_COUNT_CONTROL_REG, CYREG_B1_UDB05_06_CTL
.set Systick_Counter_CounterUDB_sCTRLReg_ctrlreg__16BIT_COUNT_COUNT_REG, CYREG_B1_UDB05_06_CTL
.set Systick_Counter_CounterUDB_sCTRLReg_ctrlreg__16BIT_MASK_MASK_REG, CYREG_B1_UDB05_06_MSK
.set Systick_Counter_CounterUDB_sCTRLReg_ctrlreg__16BIT_MASK_PERIOD_REG, CYREG_B1_UDB05_06_MSK
.set Systick_Counter_CounterUDB_sCTRLReg_ctrlreg__16BIT_PERIOD_MASK_REG, CYREG_B1_UDB05_06_MSK
.set Systick_Counter_CounterUDB_sCTRLReg_ctrlreg__16BIT_PERIOD_PERIOD_REG, CYREG_B1_UDB05_06_MSK
.set Systick_Counter_CounterUDB_sCTRLReg_ctrlreg__7__MASK, 0x80
.set Systick_Counter_CounterUDB_sCTRLReg_ctrlreg__7__POS, 7
.set Systick_Counter_CounterUDB_sCTRLReg_ctrlreg__CONTROL_AUX_CTL_REG, CYREG_B1_UDB05_ACTL
.set Systick_Counter_CounterUDB_sCTRLReg_ctrlreg__CONTROL_REG, CYREG_B1_UDB05_CTL
.set Systick_Counter_CounterUDB_sCTRLReg_ctrlreg__CONTROL_ST_REG, CYREG_B1_UDB05_ST_CTL
.set Systick_Counter_CounterUDB_sCTRLReg_ctrlreg__COUNT_REG, CYREG_B1_UDB05_CTL
.set Systick_Counter_CounterUDB_sCTRLReg_ctrlreg__COUNT_ST_REG, CYREG_B1_UDB05_ST_CTL
.set Systick_Counter_CounterUDB_sCTRLReg_ctrlreg__MASK, 0x80
.set Systick_Counter_CounterUDB_sCTRLReg_ctrlreg__MASK_CTL_AUX_CTL_REG, CYREG_B1_UDB05_MSK_ACTL
.set Systick_Counter_CounterUDB_sCTRLReg_ctrlreg__PER_CTL_AUX_CTL_REG, CYREG_B1_UDB05_MSK_ACTL
.set Systick_Counter_CounterUDB_sCTRLReg_ctrlreg__PERIOD_REG, CYREG_B1_UDB05_MSK
.set Systick_Counter_CounterUDB_sSTSReg_stsreg__0__MASK, 0x01
.set Systick_Counter_CounterUDB_sSTSReg_stsreg__0__POS, 0
.set Systick_Counter_CounterUDB_sSTSReg_stsreg__1__MASK, 0x02
.set Systick_Counter_CounterUDB_sSTSReg_stsreg__1__POS, 1
.set Systick_Counter_CounterUDB_sSTSReg_stsreg__16BIT_STATUS_AUX_CTL_REG, CYREG_B1_UDB07_08_ACTL
.set Systick_Counter_CounterUDB_sSTSReg_stsreg__16BIT_STATUS_REG, CYREG_B1_UDB07_08_ST
.set Systick_Counter_CounterUDB_sSTSReg_stsreg__2__MASK, 0x04
.set Systick_Counter_CounterUDB_sSTSReg_stsreg__2__POS, 2
.set Systick_Counter_CounterUDB_sSTSReg_stsreg__5__MASK, 0x20
.set Systick_Counter_CounterUDB_sSTSReg_stsreg__5__POS, 5
.set Systick_Counter_CounterUDB_sSTSReg_stsreg__6__MASK, 0x40
.set Systick_Counter_CounterUDB_sSTSReg_stsreg__6__POS, 6
.set Systick_Counter_CounterUDB_sSTSReg_stsreg__MASK, 0x67
.set Systick_Counter_CounterUDB_sSTSReg_stsreg__MASK_REG, CYREG_B1_UDB07_MSK
.set Systick_Counter_CounterUDB_sSTSReg_stsreg__STATUS_AUX_CTL_REG, CYREG_B1_UDB07_ACTL
.set Systick_Counter_CounterUDB_sSTSReg_stsreg__STATUS_REG, CYREG_B1_UDB07_ST

/* Miscellaneous */
.set BCLK__BUS_CLK__HZ, 24000000
.set BCLK__BUS_CLK__KHZ, 24000
.set BCLK__BUS_CLK__MHZ, 24
.set CYDEV_CHIP_DIE_LEOPARD, 1
.set CYDEV_CHIP_DIE_PANTHER, 19
.set CYDEV_CHIP_DIE_PSOC4A, 11
.set CYDEV_CHIP_DIE_PSOC5LP, 18
.set CYDEV_CHIP_DIE_TMA4, 2
.set CYDEV_CHIP_DIE_UNKNOWN, 0
.set CYDEV_CHIP_FAMILY_PSOC3, 1
.set CYDEV_CHIP_FAMILY_PSOC4, 2
.set CYDEV_CHIP_FAMILY_PSOC5, 3
.set CYDEV_CHIP_FAMILY_UNKNOWN, 0
.set CYDEV_CHIP_FAMILY_USED, CYDEV_CHIP_FAMILY_PSOC5
.set CYDEV_CHIP_JTAG_ID, 0x2E161069
.set CYDEV_CHIP_MEMBER_3A, 1
.set CYDEV_CHIP_MEMBER_4A, 11
.set CYDEV_CHIP_MEMBER_4C, 16
.set CYDEV_CHIP_MEMBER_4D, 7
.set CYDEV_CHIP_MEMBER_4E, 4
.set CYDEV_CHIP_MEMBER_4F, 12
.set CYDEV_CHIP_MEMBER_4G, 2
.set CYDEV_CHIP_MEMBER_4H, 10
.set CYDEV_CHIP_MEMBER_4I, 15
.set CYDEV_CHIP_MEMBER_4J, 8
.set CYDEV_CHIP_MEMBER_4K, 9
.set CYDEV_CHIP_MEMBER_4L, 14
.set CYDEV_CHIP_MEMBER_4M, 13
.set CYDEV_CHIP_MEMBER_4N, 6
.set CYDEV_CHIP_MEMBER_4O, 5
.set CYDEV_CHIP_MEMBER_4U, 3
.set CYDEV_CHIP_MEMBER_5A, 18
.set CYDEV_CHIP_MEMBER_5B, 17
.set CYDEV_CHIP_MEMBER_UNKNOWN, 0
.set CYDEV_CHIP_MEMBER_USED, CYDEV_CHIP_MEMBER_5B
.set CYDEV_CHIP_DIE_EXPECT, CYDEV_CHIP_MEMBER_USED
.set CYDEV_CHIP_DIE_ACTUAL, CYDEV_CHIP_DIE_EXPECT
.set CYDEV_CHIP_REV_LEOPARD_ES1, 0
.set CYDEV_CHIP_REV_LEOPARD_ES2, 1
.set CYDEV_CHIP_REV_LEOPARD_ES3, 3
.set CYDEV_CHIP_REV_LEOPARD_PRODUCTION, 3
.set CYDEV_CHIP_REV_PANTHER_ES0, 0
.set CYDEV_CHIP_REV_PANTHER_ES1, 1
.set CYDEV_CHIP_REV_PANTHER_PRODUCTION, 1
.set CYDEV_CHIP_REV_PSOC4A_ES0, 17
.set CYDEV_CHIP_REV_PSOC4A_PRODUCTION, 17
.set CYDEV_CHIP_REV_PSOC5LP_ES0, 0
.set CYDEV_CHIP_REV_PSOC5LP_PRODUCTION, 0
.set CYDEV_CHIP_REV_TMA4_ES, 17
.set CYDEV_CHIP_REV_TMA4_ES2, 33
.set CYDEV_CHIP_REV_TMA4_PRODUCTION, 17
.set CYDEV_CHIP_REVISION_3A_ES1, 0
.set CYDEV_CHIP_REVISION_3A_ES2, 1
.set CYDEV_CHIP_REVISION_3A_ES3, 3
.set CYDEV_CHIP_REVISION_3A_PRODUCTION, 3
.set CYDEV_CHIP_REVISION_4A_ES0, 17
.set CYDEV_CHIP_REVISION_4A_PRODUCTION, 17
.set CYDEV_CHIP_REVISION_4C_PRODUCTION, 0
.set CYDEV_CHIP_REVISION_4D_PRODUCTION, 0
.set CYDEV_CHIP_REVISION_4E_PRODUCTION, 0
.set CYDEV_CHIP_REVISION_4F_PRODUCTION, 0
.set CYDEV_CHIP_REVISION_4F_PRODUCTION_256DMA, 0
.set CYDEV_CHIP_REVISION_4F_PRODUCTION_256K, 0
.set CYDEV_CHIP_REVISION_4G_ES, 17
.set CYDEV_CHIP_REVISION_4G_ES2, 33
.set CYDEV_CHIP_REVISION_4G_PRODUCTION, 17
.set CYDEV_CHIP_REVISION_4H_PRODUCTION, 0
.set CYDEV_CHIP_REVISION_4I_PRODUCTION, 0
.set CYDEV_CHIP_REVISION_4J_PRODUCTION, 0
.set CYDEV_CHIP_REVISION_4K_PRODUCTION, 0
.set CYDEV_CHIP_REVISION_4L_PRODUCTION, 0
.set CYDEV_CHIP_REVISION_4M_PRODUCTION, 0
.set CYDEV_CHIP_REVISION_4N_PRODUCTION, 0
.set CYDEV_CHIP_REVISION_4O_PRODUCTION, 0
.set CYDEV_CHIP_REVISION_4U_PRODUCTION, 0
.set CYDEV_CHIP_REVISION_5A_ES0, 0
.set CYDEV_CHIP_REVISION_5A_ES1, 1
.set CYDEV_CHIP_REVISION_5A_PRODUCTION, 1
.set CYDEV_CHIP_REVISION_5B_ES0, 0
.set CYDEV_CHIP_REVISION_5B_PRODUCTION, 0
.set CYDEV_CHIP_REVISION_USED, CYDEV_CHIP_REVISION_5B_PRODUCTION
.set CYDEV_CHIP_REV_EXPECT, CYDEV_CHIP_REVISION_USED
.set CYDEV_CONFIG_FASTBOOT_ENABLED, 1
.set CYDEV_CONFIG_UNUSED_IO_AllowButWarn, 0
.set CYDEV_CONFIG_UNUSED_IO, CYDEV_CONFIG_UNUSED_IO_AllowButWarn
.set CYDEV_CONFIG_UNUSED_IO_AllowWithInfo, 1
.set CYDEV_CONFIG_UNUSED_IO_Disallowed, 2
.set CYDEV_CONFIGURATION_COMPRESSED, 0
.set CYDEV_CONFIGURATION_DMA, 1
.set CYDEV_CONFIGURATION_ECC, 1
.set CYDEV_CONFIGURATION_IMOENABLED, CYDEV_CONFIG_FASTBOOT_ENABLED
.set CYDEV_CONFIGURATION_MODE_COMPRESSED, 0
.set CYDEV_CONFIGURATION_MODE_DMA, 2
.set CYDEV_CONFIGURATION_MODE, CYDEV_CONFIGURATION_MODE_DMA
.set CYDEV_CONFIGURATION_MODE_UNCOMPRESSED, 1
.set CYDEV_DEBUG_ENABLE_MASK, 0x20
.set CYDEV_DEBUG_ENABLE_REGISTER, CYREG_MLOGIC_DEBUG
.set CYDEV_DEBUGGING_DPS_Disable, 3
.set CYDEV_DEBUGGING_DPS_JTAG_4, 1
.set CYDEV_DEBUGGING_DPS_JTAG_5, 0
.set CYDEV_DEBUGGING_DPS_SWD, 2
.set CYDEV_DEBUGGING_DPS_SWD_SWV, 6
.set CYDEV_DEBUGGING_DPS, CYDEV_DEBUGGING_DPS_SWD_SWV
.set CYDEV_DEBUGGING_ENABLE, 1
.set CYDEV_DEBUGGING_XRES, 0
.set CYDEV_DMA_CHANNELS_AVAILABLE, 24
.set CYDEV_ECC_ENABLE, 0
.set CYDEV_HEAP_SIZE, 0x80
.set CYDEV_INSTRUCT_CACHE_ENABLED, 0
.set CYDEV_INTR_RISING, 0x00000003
.set CYDEV_IS_EXPORTING_CODE, 0
.set CYDEV_IS_IMPORTING_CODE, 0
.set CYDEV_PROJ_TYPE, 0
.set CYDEV_PROJ_TYPE_BOOTLOADER, 1
.set CYDEV_PROJ_TYPE_LAUNCHER, 5
.set CYDEV_PROJ_TYPE_LOADABLE, 2
.set CYDEV_PROJ_TYPE_LOADABLEANDBOOTLOADER, 4
.set CYDEV_PROJ_TYPE_MULTIAPPBOOTLOADER, 3
.set CYDEV_PROJ_TYPE_STANDARD, 0
.set CYDEV_PROTECTION_ENABLE, 0
.set CYDEV_STACK_SIZE, 0x0800
.set CYDEV_USE_BUNDLED_CMSIS, 1
.set CYDEV_VARIABLE_VDDA, 0
.set CYDEV_VDDA_MV, 5000
.set CYDEV_VDDD_MV, 5000
.set CYDEV_VDDIO0_MV, 5000
.set CYDEV_VDDIO1_MV, 5000
.set CYDEV_VDDIO2_MV, 5000
.set CYDEV_VDDIO3_MV, 5000
.set CYDEV_VIO0_MV, 5000
.set CYDEV_VIO1_MV, 5000
.set CYDEV_VIO2_MV, 5000
.set CYDEV_VIO3_MV, 5000
.set CYIPBLOCK_ARM_CM3_VERSION, 0
.set CYIPBLOCK_P3_ANAIF_VERSION, 0
.set CYIPBLOCK_P3_CAN_VERSION, 0
.set CYIPBLOCK_P3_CAPSENSE_VERSION, 0
.set CYIPBLOCK_P3_COMP_VERSION, 0
.set CYIPBLOCK_P3_DECIMATOR_VERSION, 0
.set CYIPBLOCK_P3_DFB_VERSION, 0
.set CYIPBLOCK_P3_DMA_VERSION, 0
.set CYIPBLOCK_P3_DRQ_VERSION, 0
.set CYIPBLOCK_P3_DSM_VERSION, 0
.set CYIPBLOCK_P3_EMIF_VERSION, 0
.set CYIPBLOCK_P3_I2C_VERSION, 0
.set CYIPBLOCK_P3_LCD_VERSION, 0
.set CYIPBLOCK_P3_LPF_VERSION, 0
.set CYIPBLOCK_P3_OPAMP_VERSION, 0
.set CYIPBLOCK_P3_PM_VERSION, 0
.set CYIPBLOCK_P3_SCCT_VERSION, 0
.set CYIPBLOCK_P3_TIMER_VERSION, 0
.set CYIPBLOCK_P3_USB_VERSION, 0
.set CYIPBLOCK_P3_VIDAC_VERSION, 0
.set CYIPBLOCK_P3_VREF_VERSION, 0
.set CYIPBLOCK_S8_GPIO_VERSION, 0
.set CYIPBLOCK_S8_IRQ_VERSION, 0
.set CYIPBLOCK_S8_SAR_VERSION, 0
.set CYIPBLOCK_S8_SIO_VERSION, 0
.set CYIPBLOCK_S8_UDB_VERSION, 0
.set DMA_CHANNELS_USED__MASK0, 0x00000000
.set CYDEV_BOOTLOADER_ENABLE, 0
.endif
